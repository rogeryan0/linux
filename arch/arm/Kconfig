## arch/arm/plat-armada370/mv_drivers_lsp/mv_phone/Kconfig
```kconfig
menu "Telephony options"
	depends on MV_INCLUDE_TDM

config  MV_PHONE
	bool "Support for Marvell telephony(VoIP)"
	depends on MV_INCLUDE_TDM && PHONE
	default y
	---help---
	  Choosing this option enables the Marvell telephony underlying
	  support for various VoIP applications.
	  Note, kernel Telephony subsystem must be chosen too.

choice
	prompt "TDM Unit"
	depends on MV_PHONE
	default MV_TDM_SUPPORT_370

config MV_TDM_SUPPORT_370
	bool "Support legacy TDM(2 channels)"
	select MV_TDM_SUPPORT

config MV_COMM_UNIT_SUPPORT_370
	depends on ARCH_FEROCEON_KW2 || ARCH_ARMADA_XP
	bool "Support CommUnit(up to 32 channels)"
	select MV_COMM_UNIT_SUPPORT

endchoice

choice
	prompt "SLIC Vendor"
	depends on MV_PHONE
	default ZARLINK_SLIC_SUPPORT_370

#config SILABS_SLIC_SUPPORT
#	bool "Support Silicon Labs devices"

config ZARLINK_SLIC_SUPPORT_370
	bool "Support Zarlink/Legirity devices"
	select ZARLINK_SLIC_SUPPORT

endchoice

choice
	prompt "SLIC Device"
	depends on MV_PHONE && SILABS_SLIC_SUPPORT

config SILABS_SLIC_3215_370
	bool "Support Silicon Labs 3215 device"
	select SILABS_SLIC_3215

config SILABS_SLIC_3217_370
	bool "Support Silicon Labs 3217 device"
	select SILABS_SLIC_3217

endchoice

choice
	prompt "SLIC Device"
	depends on MV_PHONE && ZARLINK_SLIC_SUPPORT
	default ZARLINK_SLIC_VE880_370

config ZARLINK_SLIC_VE880_370
	bool "Support Zarlink VE880 SLIC family"
	select ZARLINK_SLIC_VE880

config ZARLINK_SLIC_VE792_370
	bool "Support Zarlink VE792 SLIC family"
	select ZARLINK_SLIC_VE792

endchoice

choice
	prompt "PCM Clock Frequency"
	depends on MV_PHONE
	default MV_TDM_PCM_CLK_8MHZ
	---help---
	This menu selects the PCM clock frequency generated by the TDM master.
	SLIC should be configured accordingly in order to maintain bus coherency.

config MV_TDM_PCM_CLK_8MHZ
	bool "Support 8MHz PCM clock"

config MV_TDM_PCM_CLK_4MHZ
	bool "Support 4MHz PCM clock"

config MV_TDM_PCM_CLK_2MHZ
	bool "Support 2MHz PCM clock"

endchoice

config MV_PHONE_USE_IRQ_PROCESSING
	bool "Support Rx/Tx processing in interrupt context"
	depends on MV_PHONE
	default n
	---help---
	Choosing this option supports Rx/Tx voice processing in interrupt context, otherwise
	processing is performed in tasklet context.

config MV_TDM_USE_EXTERNAL_PCLK_SOURCE
	bool "Support PCLK from external source"
	depends on MV_PHONE
	default n
	---help---
	Choosing this option enables TDM unit to use PCLK supplied by external source.

config MV_PHONE_USE_SLIC_LIBS
	bool "Use binary SLIC drivers"
	depends on MV_PHONE
	default y
	---help---
	Unselect this option only if you have source code of SLIC drivers.
	If unsure, say "y"

endmenu
```

## arch/arm/plat-armadaxp/mv_drivers_lsp/mv_phone/Kconfig
```kconfig
menu "Telephony options"
	depends on MV_INCLUDE_TDM

config  MV_PHONE
	bool "Support for Marvell telephony(VoIP)"
	depends on MV_INCLUDE_TDM && PHONE
	default m
	---help---
	  Choosing this option enables the Marvell telephony underlying 
	  support for various VoIP applications. 
	  Note, kernel Telephony subsystem must be chosen too.

choice 
	prompt "TDM unit"
	depends on MV_PHONE

config MV_TDM_SUPPORT_XP
	bool "Support legacy TDM(2 channels)"
	select MV_TDM_SUPPORT

config MV_COMM_UNIT_SUPPORT_XP
	depends on ARCH_FEROCEON_KW2
	bool "Support CommUnit(up to 32 channels)"
	select MV_COMM_UNIT_SUPPORT

endchoice

choice 
	prompt "SLIC vendor"
	depends on MV_PHONE

config SILABS_SLIC_SUPPORT
	bool "Support Silicon Labs devices"

config ZARLINK_SLIC_SUPPORT_XP
	bool "Support Zarlink/Legirity devices"
	select ZARLINK_SLIC_SUPPORT

endchoice

choice 
	prompt "SLIC type"
	depends on MV_PHONE && SILABS_SLIC_SUPPORT

config SILABS_SLIC_3215_XP
	bool "Support Silicon Labs 3215 device"
	select SILABS_SLIC_3215

config SILABS_SLIC_3217_XP
	bool "Support Silicon Labs 3217 device"
	select SILABS_SLIC_3217

endchoice

choice 
	prompt "SLIC type"
	depends on MV_PHONE && ZARLINK_SLIC_SUPPORT

config ZARLINK_SLIC_VE880_XP
	bool "Support Zarlink VE880 SLIC family"
	select ZARLINK_SLIC_VE880

config ZARLINK_SLIC_VE792_XP
	bool "Support Zarlink VE792 SLIC family"
	select ZARLINK_SLIC_VE792

endchoice


config MV_TDM_USE_EXTERNAL_PCLK_SOURCE
	bool "Support PCLK from external source"
	depends on MV_PHONE
	default n
	---help---
	Choosing this option enables TDM unit to use PCLK supplied by external source.

config TDM_DEV_TEST_SUPPORT
	bool "Support tdm testing"
	depends on MV_INCLUDE_TDM
	help
	   The tdm testing device supports several basic telephony tests on Marvell TDM based platforms.

config MV_PHONE_USE_SLIC_LIBS
	bool "Use binary slic drivers"
	default y
	---help---
	Unselect this option only if you have source code of slic drivers.
	If unsure, say "y"

config MV_COMM_UNIT_FSYNC_STRB_SUPPORT
	bool "Use CommUnit strobe pin as frame sync source"
	default y
	depends on MV_COMM_UNIT_SUPPORT
	help
	  The CommUnit frame sync 1/2/3 bit delay feature is not working in Z1 silicon revision, therefore
	  the strobe pin can be used as tunable frame sync source.

endmenu
```

## arch/arm/plat-armadaxp/mv_drivers_lsp/mv_tsu/Kconfig
```kconfig
menu "TSU options"
	depends on MV_INCLUDE_TS

config  MV_TSU
	bool "Support for Marvell Transport Stream Interface"
#	depends on MV_INCLUDE_TS
	default n

choice
	prompt "TSU interface type"
	depends on MV_TSU
	default TSU_PARALLEL_IF_XP

config TSU_SERIAL_IF_XP
	bool "Serial Interface"
	select TSU_SERIAL_IF
	---help---
	The TSU will work in serial mode (2 ports).

config TSU_PARALLEL_IF_XP
	bool "Parallel Interface"
	select TSU_PARALLEL_IF
	---help---
	The TSU will work in parallel mode (1 port).
endchoice


choice
	prompt "TSU Core-Clock"
	depends on MV_TSU
	default TSU_CORE_CLK_83MHZ_XP

config TSU_CORE_CLK_71MHZ_XP
	bool "71 MHz TSU Core Clock"
	select TSU_CORE_CLK_71MHZ

config TSU_CORE_CLK_83MHZ_XP
	bool "83 MHz TSU Core Clock"
	select TSU_CORE_CLK_83MHZ

config TSU_CORE_CLK_91MHZ_XP
	bool "91 MHz TSU Core Clock"
	select TSU_CORE_CLK_91MHZ
config TSU_CORE_CLK_100MHZ_XP
	bool "100 MHz TSU Core Clock"
	select TSU_CORE_CLK_100MHZ

endchoice

config  MV_TSU_PKT_SIZE
        int "TSU packet size"
        depends on MV_TSU
	default 188
	range 188, 256
        ---help---
          Define the TS packet size to be used (Same for both ports)
	  Must be >= 188 and <= 256.

config  MV_TSU_PROC
	bool "Support for TSU proc interface"
	depends on MV_TSU
	default y
        ---help---
          Support Proc-fs interface to configuring the TS control driver.

endmenu
```

## arch/arm/plat-feroceon/mv_drivers_lsp/mv_network/mv_ethernet/Kconfig
```kconfig
config  MV_GTW_CONFIG
	string "Network interface configuration"
	depends on MV_GATEWAY
	default "(00:11:66:11:66:11,0)(00:22:77:22:77:22,1:2:3:4),mtu=1500"
	---help---
	 Set the network interface configuration. For each interface, define the interface 
	 name, MAC address and participating ports, at the end (optionally) set the 
         interfaces MTU. For example, the default configuration defines two interfaces, 
         eth0 and eth1, and sets the MTU to 1500.

config MV_GTW_HEADER_MODE
	bool "Use Marvell Header Mode"
	depends on MV_GATEWAY && (MV88F6281 || MV88F6183)
        default y
	---help---
	  Use Marvell Header Mode to improve routing performance.

config MV_GTW_FLOW_CONTROL
	bool "Use flow-control Mode"
	depends on MV_GATEWAY && !MV_GTW_HEADER_MODE
	default n
	---help---
	  Use flow control between switch and MAC. If unsure say No.

config  MV_GTW_IGMP
        bool "L2 IGMP Snooping support"
        depends on MV_GATEWAY
        default y
        ---help---
          Support L2 IGMP snooping at the switch level, i.e. directing L3 routed multicast
          stream to the specific L2 port which originally received an IGMP Join message,
          instead of fluding all VLAN ports.

config  MV_GTW_LINK_STATUS
	bool "Link status change indications"
	depends on MV_GATEWAY
	default y
	---help---
	  Support Phy link status change indications.

config MV_GTW_QOS
        bool "ToS based QoS support"
        depends on MV_GATEWAY && (MV_ETH_RX_Q_NUM != 1)
        default y
        ---help---
          Priorities packets marked with predefined ToS in IP header comming from WAN interface. 

config MV_GTW_QOS_NET_IF
        string "Name of network interface which require QoS"
        depends on MV_GTW_QOS
        default "eth0" 

config MV_GTW_QOS_VOIP
        bool "VoIP QoS"
        depends on MV_GTW_QOS
        default y

config MV_GTW_QOS_VOIP_TOS
        string "VoIP ToS value"
        depends on MV_GTW_QOS_VOIP
        default "0xA0"

config MV_GTW_QOS_ROUTING
        bool "Routing QoS"
        depends on MV_GTW_QOS
        default y

config MV_GTW_QOS_ROUTING_TOS
        string "Routing ToS value"
        depends on MV_GTW_QOS_ROUTING
        default "0x11;0x22"
```

## drivers/video/display/Kconfig
```kconfig
#
# Display drivers configuration
#

menu "Display device support"

config ADI9889
	tristate "ADI9889 support"
	default y
	help
	  ADI9889 device driver support.
config THS8200
	tristate "THS8200 support"
	default y
	help
	  THS8200 device driver support.
endmenu
```
