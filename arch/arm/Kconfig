## arch/arm/configs/buffalo_ls400_defconfig
```kconfig
# CONFIG_ARM_PATCH_PHYS_VIRT is not set
CONFIG_EXPERIMENTAL=y
CONFIG_CROSS_COMPILE="arm-mv7-linux-gnueabi-"
CONFIG_SYSVIPC=y
CONFIG_SCHED_AUTOGROUP=y
CONFIG_BLK_DEV_INITRD=y
CONFIG_CC_OPTIMIZE_FOR_SIZE=y
CONFIG_SYSCTL_SYSCALL=y
CONFIG_EMBEDDED=y
CONFIG_SLAB=y
CONFIG_PROFILING=y
CONFIG_OPROFILE=m
CONFIG_MODULES=y
CONFIG_MODULE_UNLOAD=y
# CONFIG_BLK_DEV_BSG is not set
CONFIG_PARTITION_ADVANCED=y
CONFIG_EFI_PARTITION=y
CONFIG_ARCH_ARMADA370=y
# CONFIG_MV_INCLUDE_TDM is not set
CONFIG_MV_SPI_BOOT=y
CONFIG_MTD_NAND_NFC_370=y
CONFIG_MTD_NAND_NFC_GANG_SUPPORT_370=y
CONFIG_MTD_NAND_NFC_MLC_SUPPORT_370=y
CONFIG_FEROCEON_PROC=y
CONFIG_MV_PMU_PROC=y
CONFIG_MV_ETH_PORTS_NUM=2
CONFIG_MV_LINUX_COUNTERS_DISABLE=y
CONFIG_NET_SKB_HEADROOM=96
# CONFIG_NET_SKB_RECYCLE is not set
# CONFIG_MV_ETH_BM is not set
# CONFIG_MV_ETH_PNC is not set
CONFIG_MV_ETH_TXQ_DESC=512
CONFIG_MV_ETH_GRO_DEF=y
CONFIG_MV_ETH_TSO_DEF=y
# CONFIG_MV_ETH_STAT_INF is not set
CONFIG_MV_ETH_RX_DESC_PREFETCH=y
CONFIG_MV_ETH_RX_PKT_PREFETCH=y
CONFIG_MV_ETH_SWITCH=y
CONFIG_MV_ETH_SWITCH_NETDEV_NUM=5
# CONFIG_MV_ETH_REDUCE_BURST_SIZE_WA is not set
CONFIG_MV_CESA_TOOL=y
CONFIG_MV_CESA_CHAIN_MODE=y
CONFIG_MV_CESA_OCF_370=y
CONFIG_SHEEVA_DEEP_IDLE=y
CONFIG_ARMADA_SUPPORT_DEEP_IDLE_DRAM_SR=y
CONFIG_NO_HZ=y
CONFIG_AEABI=y
CONFIG_REORDER=y
CONFIG_HIGHMEM=y
CONFIG_COMPACTION=y
CONFIG_UACCESS_WITH_MEMCPY=y
CONFIG_ZBOOT_ROM_TEXT=0x0
CONFIG_ZBOOT_ROM_BSS=0x0
CONFIG_CPU_IDLE=y
CONFIG_VFP=y
# CONFIG_CORE_DUMP_DEFAULT_ELF_HEADERS is not set
CONFIG_PM_RUNTIME=y
CONFIG_NET=y
CONFIG_PACKET=y
CONFIG_UNIX=y
CONFIG_INET=y
CONFIG_IP_MULTICAST=y
CONFIG_IP_PNP=y
CONFIG_IP_PNP_DHCP=y
CONFIG_IP_PNP_BOOTP=y
# CONFIG_IPV6 is not set
CONFIG_BRIDGE=y
CONFIG_NET_PKTGEN=m
CONFIG_UEVENT_HELPER_PATH="/sbin/hotplug"
CONFIG_DEVTMPFS=y
CONFIG_MTD=y
CONFIG_MTD_CMDLINE_PARTS=y
CONFIG_MTD_CHAR=y
CONFIG_MTD_BLOCK=y
CONFIG_MTD_CFI=y
CONFIG_MTD_JEDECPROBE=y
CONFIG_MTD_CFI_ADV_OPTIONS=y
CONFIG_MTD_CFI_GEOMETRY=y
# CONFIG_MTD_MAP_BANK_WIDTH_4 is not set
CONFIG_MTD_CFI_INTELEXT=y
CONFIG_MTD_CFI_STAA=y
CONFIG_MTD_PHYSMAP=y
CONFIG_MTD_M25P80=y
CONFIG_MTD_NAND=y
CONFIG_MTD_NAND_VERIFY_WRITE=y
CONFIG_MTD_UBI=y
CONFIG_BLK_DEV_LOOP=y
CONFIG_BLK_DEV_RAM=y
CONFIG_BLK_DEV_RAM_SIZE=65536
CONFIG_BLK_DEV_SD=y
CONFIG_BLK_DEV_SR=m
CONFIG_CHR_DEV_SG=m
CONFIG_SCSI_MV_THOR=m
CONFIG_ATA=y
CONFIG_SATA_MV=y
CONFIG_MD=y
CONFIG_BLK_DEV_MD=y
CONFIG_MD_LINEAR=y
CONFIG_MD_RAID0=y
CONFIG_MD_RAID1=y
CONFIG_MD_RAID10=y
CONFIG_MD_RAID456=y
CONFIG_NETDEVICES=y
CONFIG_MII=y
CONFIG_TUN=m
# CONFIG_NET_VENDOR_3COM is not set
# CONFIG_NET_VENDOR_ADAPTEC is not set
# CONFIG_NET_VENDOR_ALTEON is not set
# CONFIG_NET_VENDOR_AMD is not set
# CONFIG_NET_VENDOR_ATHEROS is not set
# CONFIG_NET_VENDOR_BROADCOM is not set
# CONFIG_NET_VENDOR_BROCADE is not set
# CONFIG_NET_VENDOR_CHELSIO is not set
# CONFIG_NET_VENDOR_CISCO is not set
# CONFIG_NET_VENDOR_DEC is not set
# CONFIG_NET_VENDOR_DLINK is not set
# CONFIG_NET_VENDOR_EMULEX is not set
# CONFIG_NET_VENDOR_EXAR is not set
# CONFIG_NET_VENDOR_FARADAY is not set
# CONFIG_NET_VENDOR_HP is not set
# CONFIG_NET_VENDOR_INTEL is not set
CONFIG_SKY2=y
# CONFIG_NET_VENDOR_MELLANOX is not set
# CONFIG_NET_VENDOR_MICREL is not set
# CONFIG_NET_VENDOR_MICROCHIP is not set
# CONFIG_NET_VENDOR_MYRI is not set
# CONFIG_NET_VENDOR_NATSEMI is not set
# CONFIG_NET_VENDOR_NVIDIA is not set
# CONFIG_NET_VENDOR_OKI is not set
# CONFIG_NET_PACKET_ENGINE is not set
# CONFIG_NET_VENDOR_QLOGIC is not set
# CONFIG_NET_VENDOR_REALTEK is not set
# CONFIG_NET_VENDOR_RDC is not set
# CONFIG_NET_VENDOR_SEEQ is not set
# CONFIG_NET_VENDOR_SILAN is not set
# CONFIG_NET_VENDOR_SIS is not set
# CONFIG_NET_VENDOR_SMSC is not set
# CONFIG_NET_VENDOR_STMICRO is not set
# CONFIG_NET_VENDOR_SUN is not set
# CONFIG_NET_VENDOR_TEHUTI is not set
# CONFIG_NET_VENDOR_TI is not set
# CONFIG_NET_VENDOR_VIA is not set
# CONFIG_WLAN is not set
# CONFIG_INPUT is not set
# CONFIG_SERIO is not set
# CONFIG_VT is not set
CONFIG_LEGACY_PTY_COUNT=16
# CONFIG_DEVKMEM is not set
CONFIG_SERIAL_8250=y
CONFIG_SERIAL_8250_CONSOLE=y
# CONFIG_SERIAL_8250_PCI is not set
CONFIG_SERIAL_8250_RUNTIME_UARTS=2
# CONFIG_HW_RANDOM is not set
CONFIG_I2C=y
CONFIG_I2C_CHARDEV=y
CONFIG_I2C_MUX=y
CONFIG_I2C_MUX_GPIO=y
CONFIG_I2C_MV64XXX=y
CONFIG_SPI=y
CONFIG_GPIO_SYSFS=y
CONFIG_THERMAL=y
CONFIG_FB=y
CONFIG_FB_MODE_HELPERS=y
CONFIG_BACKLIGHT_LCD_SUPPORT=y
CONFIG_LCD_CLASS_DEVICE=y
CONFIG_BACKLIGHT_CLASS_DEVICE=y
CONFIG_USB=m
CONFIG_USB_DEVICEFS=y
CONFIG_USB_SUSPEND=y
CONFIG_USB_XHCI_HCD=m
CONFIG_USB_EHCI_HCD=m
CONFIG_USB_EHCI_ROOT_HUB_TT=y
CONFIG_USB_OHCI_HCD=m
CONFIG_USB_PRINTER=m
CONFIG_USB_STORAGE=m
CONFIG_MMC=y
CONFIG_MMC_MVSDIO=y
CONFIG_NEW_LEDS=y
CONFIG_RTC_CLASS=y
CONFIG_RTC_DRV_RS5C372=y
CONFIG_DMADEVICES=y
CONFIG_MV_XOR=y
CONFIG_ASYNC_TX_DMA=y
CONFIG_EXT2_FS=y
CONFIG_EXT3_FS=y
# CONFIG_EXT3_DEFAULTS_TO_ORDERED is not set
# CONFIG_EXT3_FS_XATTR is not set
CONFIG_EXT4_FS=y
# CONFIG_EXT4_FS_XATTR is not set
CONFIG_XFS_FS=y
CONFIG_XFS_QUOTA=y
CONFIG_XFS_POSIX_ACL=y
CONFIG_QUOTA=y
# CONFIG_PRINT_QUOTA_WARNING is not set
CONFIG_FUSE_FS=y
CONFIG_ISO9660_FS=m
CONFIG_JOLIET=y
CONFIG_UDF_FS=m
CONFIG_MSDOS_FS=y
CONFIG_VFAT_FS=y
CONFIG_FAT_DEFAULT_IOCHARSET="utf8"
CONFIG_TMPFS=y
CONFIG_HFSPLUS_FS=y
CONFIG_JFFS2_FS=y
CONFIG_UBIFS_FS=y
CONFIG_UBIFS_FS_ADVANCED_COMPR=y
CONFIG_NFS_FS=y
CONFIG_NFS_V3=y
CONFIG_ROOT_NFS=y
CONFIG_NLS_DEFAULT="utf8"
CONFIG_NLS_CODEPAGE_437=y
CONFIG_NLS_CODEPAGE_737=m
CONFIG_NLS_CODEPAGE_775=m
CONFIG_NLS_CODEPAGE_850=m
CONFIG_NLS_CODEPAGE_852=m
CONFIG_NLS_CODEPAGE_855=m
CONFIG_NLS_CODEPAGE_857=m
CONFIG_NLS_CODEPAGE_860=m
CONFIG_NLS_CODEPAGE_861=m
CONFIG_NLS_CODEPAGE_862=m
CONFIG_NLS_CODEPAGE_863=m
CONFIG_NLS_CODEPAGE_864=m
CONFIG_NLS_CODEPAGE_865=m
CONFIG_NLS_CODEPAGE_866=m
CONFIG_NLS_CODEPAGE_869=m
CONFIG_NLS_CODEPAGE_936=m
CONFIG_NLS_CODEPAGE_950=m
CONFIG_NLS_CODEPAGE_932=y
CONFIG_NLS_CODEPAGE_949=m
CONFIG_NLS_CODEPAGE_874=m
CONFIG_NLS_ISO8859_8=m
CONFIG_NLS_CODEPAGE_1250=m
CONFIG_NLS_CODEPAGE_1251=m
CONFIG_NLS_ASCII=m
CONFIG_NLS_ISO8859_1=m
CONFIG_NLS_ISO8859_2=m
CONFIG_NLS_ISO8859_3=m
CONFIG_NLS_ISO8859_4=m
CONFIG_NLS_ISO8859_5=m
CONFIG_NLS_ISO8859_6=m
CONFIG_NLS_ISO8859_7=m
CONFIG_NLS_ISO8859_9=m
CONFIG_NLS_ISO8859_13=m
CONFIG_NLS_ISO8859_14=m
CONFIG_NLS_ISO8859_15=m
CONFIG_NLS_KOI8_R=m
CONFIG_NLS_KOI8_U=m
CONFIG_MAGIC_SYSRQ=y
# CONFIG_FTRACE is not set
CONFIG_DEBUG_USER=y
CONFIG_CRYPTO_CBC=m
CONFIG_CRYPTO_ECB=m
CONFIG_CRYPTO_PCBC=m
# CONFIG_CRYPTO_ANSI_CPRNG is not set
# CONFIG_CRYPTO_HW is not set
CONFIG_OCF_OCF=y
CONFIG_OCF_CRYPTODEV=y
CONFIG_CRC_CCITT=y
CONFIG_LIBCRC32C=y
CONFIG_BUFFALO_PLATFORM=y
CONFIG_BUFFALO_USE_KERNEVNT=y
CONFIG_BUFFALO_USE_MD_KERNEVNT=y
CONFIG_BUFFALO_USE_MD_DEGRADE_KERNEVNT=y
CONFIG_BUFFALO_USE_MD_SCAN_KERNEVNT=y
CONFIG_BUFFALO_USE_MD_REBUILD_KERNEVNT=y
CONFIG_BUFFALO_ERRCNT=y
# CONFIG_BUFFALO_DUPLICATE_SUPERBLOCK is not set
# CONFIG_BUFFALO_DUPLICATE_SUPERBLOCK_DEBUG is not set
CONFIG_BUFFALO_UBOOT_PARAMS=y
CONFIG_BUFFALO_IOERRS=y
CONFIG_BUFFALO_DISABLE_NCQ=y
CONFIG_BUFFALO_SKIP_RESYNC=y
CONFIG_BUFFALO_IGNORE_LUN=y
CONFIG_BUFFALO_SCSI_GUID=y
CONFIG_BUFFALO_EXT23_EXTENSION=y
CONFIG_BUFFALO_SATA_HOTPLUG_EVENT=y
CONFIG_BUFFALO_NTFS_CPU32_FIX=y
```

## arch/arm/mach-feroceon-orion/LSP/mv_ethernet/Kconfig
```kconfig
config  ETH_0_MACADDR
	string "Ethernet port MAC address"
	depends on MV_ETHERNET
	default "000000000051"
	---help---
	  Set the Ethernet port MAC address.

config  EGIGA_PROC
	bool "egiga proc FS (for mvEgigaTool)"
	depends on MV_ETHERNET && !MV_INCLUDE_UNM_ETH
	---help---
	  Use mvEgigaTool proc FS.
```

## arch/arm/mach-feroceon-orion/LSP/mv_gateway/Kconfig
```kconfig
config  MV_NET_CONFIG
	string "Network interface configuration"
	depends on MV_GATEWAY
	default "(eth0,00:11:66:11:66:11,0)(eth1,00:22:77:22:77:22,1:2:3:4)"
	---help---
	 Set the network interface configuration. For each interface, define the interface 
	 name, MAC address and participating ports. For example, the default configuration 
	 defines two interfaces, eth0 and eth1.

config  MV_GTW_PROC
        bool "mv_gateway /proc API support (for mvGtwTool)"
        depends on MV_GATEWAY
        ---help---

config  HAVE_ARCH_DEV_ALLOC_SKB
        bool "Customize SKB headroom size"
        depends on MV_GATEWAY
        default n
        ---help---
          Customize SKB headroom size used in dev_alloc_skb() kernel function.
```
